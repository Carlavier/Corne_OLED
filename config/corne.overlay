&pro_micro_i2c {
    status = "okay";

    oled: ssd1306@3c {
        compatible = "solomon,ssd1306fb";
        reg = <0x3c>;
        width = <128>;
        height = <32>;
        segment-remap;
        com-invdir;
        
        /* --- LEGACY 128x32 SCREEN EXPANSION --- */
        com-sequential;
        
        prechargep = <0x22>;
    };
};
